## libs/Kconfig
```kconfig
# SPDX-License-Identifier: MIT License

menu "Custom libraries"

rsource "common/Kconfig"

endmenu
```

## libs/common/Kconfig
```kconfig
# SPDX-License-Identifier: MIT License

config FW_SHELL
	bool "Enable FW shell"
	depends on SHELL=y
	default SHELL
	select LOG_OUTPUT
	help
		Enable the firmware shell
		depends on SOS_SHELL=y
		default SOS_SHELL
		help
			Enable LED shell commmands
```

## tests/libs/ew25/firmware/testcase.yaml
```yaml
# SPDX-License-Identifier: MIT License

common:
  tags: firmware 
    
tests:
  libs.ew25.firmware:
    platform_allow: native_sim
```

## west.yml
```yaml
manifest:
  remotes:
    - name: zephyr
      url-base: https://github.com/zephyrproject-rtos/

  projects:
    - name: zephyr
      path: zephyr
      remote: zephyr
      revision: v4.0.0
      import:
        true
```
